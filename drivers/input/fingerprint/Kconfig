## drivers/input/fingerprint/Kconfig
```kconfig
#
# Touchscreen driver configuration
#
menuconfig INPUT_FINGERPRINT
	bool "Fingerprint"
	help
	  Say Y here, and a list of supported fingerprint will be displayed.
	  This option doesn't affect the kernel.

	  If unsure, say Y.

if INPUT_TOUCHSCREEN


config COMMON_FINGERPRINT
	bool "COMMON_FP for Qualcomm package"
	help
	  Say Y here if you have a common fingerprint.

          If unsure, say N.

config GOODIX_FP
	bool "GOODIX_FP for Qualcomm package"
	help
	  Say Y here if you have a goodix fingerprint.

          If unsure, say N.

config CDFINGER_FP
	bool "CDFINGER_FP for Qualcomm package"
	help
	  Say Y here if you have a cdfinger fingerprint.

          If unsure, say N.

endif
```
